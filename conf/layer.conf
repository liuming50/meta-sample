## conf/layer.conf
```bitbake
# We have a conf and classes directory, add to BBPATH
BBPATH .= ":${LAYERDIR}"

# We have recipes-* directories, add to BBFILES
BBFILES += "${LAYERDIR}/recipes-*/*/*.bb \
            ${LAYERDIR}/recipes-*/*/*.bbappend"

BBFILE_COLLECTIONS += "sample"
BBFILE_PATTERN_sample = "^${LAYERDIR}/"
BBFILE_PRIORITY_sample = "10"

LAYERVERSION_sample = "1"
LAYERDEPENDS_sample = "core openembedded-layer"
LAYERSERIES_COMPAT_sample = "thud warrior zeus dunfell"
```
